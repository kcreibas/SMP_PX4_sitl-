## src/modules/smp/Kconfig
```kconfig
menuconfig MODULES_SMP
	bool "smp"
	default n
	---help---
		Enable support for smp

menuconfig USER_SMP
	bool "smp running as userspace module"
	default n
	depends on BOARD_PROTECTED && MODULES_SMP
	---help---
		Put smp in userspace memory
```

## src/systemcmds/smp_test/Kconfig
```kconfig
menuconfig SYSTEMCMDS_SMP_TEST
	bool "smp_test"
	default n
	---help---
		Enable support for smp_test
```
